/* Minimal SSD1306 driver, see oled_ssd1306.h */

#include "oled_ssd1306.h"

#include <string.h>

#include <driver/i2c_master.h>
#include <esp_log.h>

static const char *TAG = "oled";

#define OLED_CTRL_CMD 0x00
#define OLED_CTRL_DATA 0x40
#define OLED_I2C_TIMEOUT_MS 100

static i2c_master_bus_handle_t s_bus = NULL;
static i2c_master_dev_handle_t s_dev = NULL;
static bool s_ready = false;

/* One byte per column per page; bit 0 is the top pixel of the page */
static uint8_t s_buf[OLED_WIDTH * OLED_PAGES];

/* 5x7 font, ASCII 0x20..0x7E, one byte per column, LSB at the top */
static const uint8_t s_font[95][5] = {
    {0x00, 0x00, 0x00, 0x00, 0x00}, /*   */
    {0x00, 0x00, 0x5F, 0x00, 0x00}, /* ! */
    {0x00, 0x07, 0x00, 0x07, 0x00}, /* " */
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    {0x08, 0x08, 0x2A, 0x1C, 0x08}, /* ~ */
};

static esp_err_t oled_cmd(uint8_t cmd)
{
    uint8_t payload[2] = {OLED_CTRL_CMD, cmd};
    return i2c_master_transmit(s_dev, payload, sizeof(payload), OLED_I2C_TIMEOUT_MS);
}

esp_err_t oled_init(int sda, int scl, uint8_t i2c_addr)
{
    i2c_master_bus_config_t bus_cfg = {
        .i2c_port = I2C_NUM_0,
        .sda_io_num = sda,
        .scl_io_num = scl,
        .clk_source = I2C_CLK_SRC_DEFAULT,
        .glitch_ignore_cnt = 7,
        .flags = {.enable_internal_pullup = true},
    };
    esp_err_t err = i2c_new_master_bus(&bus_cfg, &s_bus);
    if (err != ESP_OK) {
        ESP_LOGE(TAG, "i2c_new_master_bus failed: %s", esp_err_to_name(err));
        return err;
    }

    /* Probe first, so a missing panel is reported here and not halfway through */
    err = i2c_master_probe(s_bus, i2c_addr, 100);
    if (err != ESP_OK) {
        ESP_LOGE(TAG, "No panel at 0x%02X on SDA=%d SCL=%d: %s", i2c_addr, sda, scl,
                 esp_err_to_name(err));
        goto fail;
    }

    i2c_device_config_t dev_cfg = {
        .dev_addr_length = I2C_ADDR_BIT_LEN_7,
        .device_address = i2c_addr,
        .scl_speed_hz = 400000,
    };
    err = i2c_master_bus_add_device(s_bus, &dev_cfg, &s_dev);
    if (err != ESP_OK) {
        ESP_LOGE(TAG, "i2c_master_bus_add_device failed: %s", esp_err_to_name(err));
        goto fail;
    }

    /* Standard 128x64 bring-up sequence */
    static const uint8_t init_seq[] = {
        0xAE,       /* display off */
        0xD5, 0x80, /* clock divide */
        0xA8, 0x3F, /* multiplex ratio = 63 */
        0xD3, 0x00, /* display offset */
        0x40,       /* start line 0 */
        0x8D, 0x14, /* charge pump on */
        0x20, 0x02, /* page addressing mode - flush() writes page by page */
        0xA1,       /* segment remap, module mounted the usual way up */
        0xC8,       /* COM scan direction reversed */
        0xDA, 0x12, /* COM pins config */
        0x81, 0x7F, /* contrast */
        0xD9, 0xF1, /* pre-charge */
        0xDB, 0x40, /* VCOM detect */
        0xA4,       /* resume from RAM */
        0xA6,       /* normal, not inverted */
        0xAF,       /* display on */
    };
    for (size_t i = 0; i < sizeof(init_seq); i++) {
        err = oled_cmd(init_seq[i]);
        if (err != ESP_OK) {
            ESP_LOGE(TAG, "Init command 0x%02X failed: %s", init_seq[i], esp_err_to_name(err));
            goto fail;
        }
    }

    s_ready = true;
    oled_clear();
    oled_flush();
    ESP_LOGI(TAG, "SSD1306 ready at 0x%02X (SDA=%d SCL=%d)", i2c_addr, sda, scl);
    return ESP_OK;

fail:
    if (s_dev) {
        i2c_master_bus_rm_device(s_dev);
        s_dev = NULL;
    }
    i2c_del_master_bus(s_bus);
    s_bus = NULL;
    return err;
}

bool oled_is_ready(void)
{
    return s_ready;
}

void oled_clear(void)
{
    memset(s_buf, 0, sizeof(s_buf));
}

void oled_text(uint8_t line, uint8_t col, const char *text)
{
    if (line >= OLED_PAGES || text == NULL) {
        return;
    }

    uint8_t *page = &s_buf[line * OLED_WIDTH];
    int x = col * 6;

    for (const char *p = text; *p != '\0'; p++) {
        if (x + 5 > OLED_WIDTH) {
            break; /* clip at the right edge rather than wrapping */
        }
        unsigned char c = (unsigned char)*p;
        if (c < 0x20 || c > 0x7E) {
            c = '?'; /* the font is ASCII only */
        }
        const uint8_t *glyph = s_font[c - 0x20];
        for (int i = 0; i < 5; i++) {
            page[x + i] = glyph[i];
        }
        page[x + 5] = 0x00; /* one column of spacing */
        x += 6;
    }
}

esp_err_t oled_flush(void)
{
    if (!s_ready) {
        return ESP_ERR_INVALID_STATE;
    }

    esp_err_t err = ESP_OK;
    for (uint8_t page = 0; page < OLED_PAGES; page++) {
        err = oled_cmd(0xB0 + page); /* page start */
        if (err != ESP_OK) {
            return err;
        }
        err = oled_cmd(0x00); /* lower column start */
        if (err != ESP_OK) {
            return err;
        }
        err = oled_cmd(0x10); /* higher column start */
        if (err != ESP_OK) {
            return err;
        }

        uint8_t chunk[1 + OLED_WIDTH];
        chunk[0] = OLED_CTRL_DATA;
        memcpy(&chunk[1], &s_buf[page * OLED_WIDTH], OLED_WIDTH);
        err = i2c_master_transmit(s_dev, chunk, sizeof(chunk), OLED_I2C_TIMEOUT_MS);
        if (err != ESP_OK) {
            return err;
        }
    }
    return ESP_OK;
}
